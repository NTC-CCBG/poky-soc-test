## nuvoton-yocto/build-rpi/conf/bblayers.conf
```bitbake
# POKY_BBLAYERS_CONF_VERSION is increased each time build/conf/bblayers.conf
# changes incompatibly
POKY_BBLAYERS_CONF_VERSION = "2"

BBPATH = "${TOPDIR}"
BBFILES ?= ""

BBLAYERS ?= " \
  /home/tmyu0/yocto/kirkstone/poky/meta \
  /home/tmyu0/yocto/kirkstone/poky/meta-poky \
  /home/tmyu0/yocto/kirkstone/poky/meta-yocto-bsp \
  /home/tmyu0/yocto/kirkstone/poky/meta-nuvoton \
  /home/tmyu0/yocto/kirkstone/poky/meta-raspberrypi \
  /home/tmyu0/yocto/kirkstone/poky/meta-openembedded/meta-oe \
  "
```

## nuvoton-yocto/meta-nuvoton/conf/layer.conf
```bitbake
# We have a conf and classes directory, add to BBPATH
BBPATH .= ":${LAYERDIR}"

# We have recipes-* directories, add to BBFILES
BBFILES += "${LAYERDIR}/recipes-*/*/*.bb \
            ${LAYERDIR}/recipes-*/*/*.bbappend"

BBFILE_COLLECTIONS += "meta-nuvoton"
BBFILE_PATTERN_meta-nuvoton = "^${LAYERDIR}/"
BBFILE_PRIORITY_meta-nuvoton = "6"

LAYERDEPENDS_meta-nuvoton = "core"
LAYERSERIES_COMPAT_meta-nuvoton = "kirkstone"
```
